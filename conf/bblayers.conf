## conf/bblayers.conf
```bitbake
# POKY_BBLAYERS_CONF_VERSION is increased each time build/conf/bblayers.conf
# changes incompatibly
POKY_BBLAYERS_CONF_VERSION = "2"

BBPATH = "${TOPDIR}"
BBFILES ?= ""

BBLAYERS ?= " \
  /home/amine/yocto/poky/meta \
  /home/amine/yocto/poky/meta-poky \
  /home/amine/yocto/poky/meta-yocto-bsp \
  /home/amine/yocto/poky/meta-raspberrypi \
  /home/amine/yocto/poky/meta-openembedded/meta-oe \
  /home/amine/yocto/poky/meta-openembedded/meta-python \
  /home/amine/yocto/poky/meta-openembedded/meta-networking \
  /home/amine/yocto/poky/meta-mylayer \
  "
```
